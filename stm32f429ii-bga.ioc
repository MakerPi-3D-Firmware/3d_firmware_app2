# file: stm32f429ii-bga.ioc
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ADC1.Channel-0\#ChannelRegularConversion=ADC_CHANNEL_0
ADC1.ClockPrescaler=ADC_CLOCK_SYNC_PCLK_DIV4
ADC1.ContinuousConvMode=ENABLE
ADC1.DataAlign=ADC_DATAALIGN_RIGHT
ADC1.EOCSelection=ADC_EOC_SINGLE_CONV
ADC1.EnableAnalogWatchDog=false
ADC1.NbrOfConversionFlag=1
ADC1.Rank-0\#ChannelRegularConversion=1
ADC1.Resolution=ADC_RESOLUTION_10B
ADC1.SamplingTime-0\#ChannelRegularConversion=ADC_SAMPLETIME_3CYCLES
ADC1.ScanConvMode=ENABLE
ADC1.master=1
DMA2D.ColorMode=DMA2D_OUTPUT_RGB565
DMA2D.Mode=DMA2D_R2M
Dma.Request0=USART1_RX
Dma.Request1=USART1_TX
Dma.USART1_RX.0.Direction=DMA_PERIPH_TO_MEMORY
Dma.USART1_RX.0.FIFOMode=DMA_FIFOMODE_DISABLE
Dma.USART1_RX.0.Instance=DMA2_Stream5
Dma.USART1_RX.0.MemDataAlignment=DMA_MDATAALIGN_BYTE
Dma.USART1_RX.0.MemInc=DMA_MINC_ENABLE
Dma.USART1_RX.0.Mode=DMA_NORMAL
Dma.USART1_RX.0.PeriphDataAlignment=DMA_PDATAALIGN_BYTE
Dma.USART1_RX.0.PeriphInc=DMA_PINC_DISABLE
Dma.USART1_RX.0.Priority=DMA_PRIORITY_LOW
Dma.USART1_TX.1.Direction=DMA_MEMORY_TO_PERIPH
Dma.USART1_TX.1.FIFOMode=DMA_FIFOMODE_DISABLE
Dma.USART1_TX.1.Instance=DMA2_Stream7
Dma.USART1_TX.1.MemDataAlignment=DMA_MDATAALIGN_BYTE
Dma.USART1_TX.1.MemInc=DMA_MINC_ENABLE
Dma.USART1_TX.1.Mode=DMA_NORMAL
Dma.USART1_TX.1.PeriphDataAlignment=DMA_PDATAALIGN_BYTE
Dma.USART1_TX.1.PeriphInc=DMA_PINC_DISABLE
Dma.USART1_TX.1.Priority=DMA_PRIORITY_LOW
FATFS._CODE_PAGE=936
FATFS._FS_LOCK=16
FATFS._MAX_LFN=64
FATFS._USE_LFN=3
FMC.AttributeSpaceHiZSetupTime1=1
FMC.AttributeSpaceHoldSetupTime1=2
FMC.AttributeSpaceSetupTime1=2
FMC.AttributeSpaceWaitSetupTime1=3
FMC.CASLatency1=FMC_SDRAM_CAS_LATENCY_3
FMC.ColumnBitsNumber1=FMC_SDRAM_COLUMN_BITS_NUM_9
FMC.CommonSpaceHiZSetupTime1=1
FMC.CommonSpaceHoldSetupTime1=2
FMC.CommonSpaceSetupTime1=2
FMC.CommonSpaceWaitSetupTime1=3
FMC.ECCPageSize1=FMC_NAND_ECC_PAGE_SIZE_2048BYTE
FMC.ExitSelfRefreshDelay1=8
FMC.LoadToActiveDelay1=2
FMC.NandBlockNbr1=4096
FMC.NandBlockSize1=64
FMC.NandPageSize1=2048
FMC.NandSpareAreaSize1=64
FMC.RCDDelay1=2
FMC.RPDelay1=2
FMC.RPDelay2=2
FMC.ReadBurst1=FMC_SDRAM_RBURST_ENABLE
FMC.ReadBurst2=FMC_SDRAM_RBURST_ENABLE
FMC.ReadPipeDelay1=FMC_SDRAM_RPIPE_DELAY_1
FMC.ReadPipeDelay2=FMC_SDRAM_RPIPE_DELAY_1
FMC.RowCycleDelay1=6
FMC.RowCycleDelay2=6
FMC.SDClockPeriod1=FMC_SDRAM_CLOCK_PERIOD_2
FMC.SDClockPeriod2=FMC_SDRAM_CLOCK_PERIOD_2
FMC.SelfRefreshTime1=6
FMC.WriteRecoveryTime1=4
FREERTOS.CountingSemaphores01=GUISendSem,2,Dynamic,NULL;GUIWaitSem,2,Dynamic,NULL;ReadUdiskSem,2,Dynamic,NULL;ReceiveUartCmd,2,Dynamic,NULL
FREERTOS.INCLUDE_uxTaskGetStackHighWaterMark=1
FREERTOS.Queues01=GcodeCommand,64,uint32_t,0,Dynamic,NULL,NULL
FREERTOS.Tasks01=InitTask,3,512,InitTask_OS,Default,NULL,Dynamic,NULL,NULL;RefDataTask,2,1024,RefDataTask_OS,Default,NULL,Dynamic,NULL,NULL;ReadUdiskTask,2,512,ReadUdiskTask_OS,Default,NULL,Dynamic,NULL,NULL;PrintTask,2,1536,PrintTask_OS,Default,NULL,Dynamic,NULL,NULL;GUITask,2,1024,GUITask_OS,Default,NULL,Dynamic,NULL,NULL;RespondGUITask,0,512,RespondGUITask_OS,Default,NULL,Dynamic,NULL,NULL
FREERTOS.configENABLE_FPU=1
FREERTOS.configTOTAL_HEAP_SIZE=24576
FREERTOS.configUSE_COUNTING_SEMAPHORES=1
FREERTOS.configUSE_STATS_FORMATTING_FUNCTIONS=1
FREERTOS.configUSE_TICKLESS_IDLE=0
FREERTOS.configUSE_TICK_HOOK=0
FREERTOS.configUSE_TRACE_FACILITY=1
IWDG.Prescaler=IWDG_PRESCALER_64
IWDG.Reload=4000
LTDC.ActiveH=600
LTDC.ActiveW=1024
LTDC.Alpha_L0=0
LTDC.Alpha_L1=0
LTDC.BlendingFactor1_L0=LTDC_BLENDING_FACTOR1_CA
LTDC.BlendingFactor1_L1=LTDC_BLENDING_FACTOR1_CA
LTDC.BlendingFactor2_L0=LTDC_BLENDING_FACTOR2_CA
LTDC.BlendingFactor2_L1=LTDC_BLENDING_FACTOR2_CA
LTDC.FBStartAdress_L0=0
LTDC.FBStartAdress_L1=0
LTDC.HBP=140
LTDC.HFP=160
LTDC.HSync=20
LTDC.ImageHeight_L0=0
LTDC.ImageHeight_L1=0
LTDC.ImageWidth_L0=0
LTDC.ImageWidth_L1=0
LTDC.Layers=0
LTDC.PixelFormat_L0=LTDC_PIXEL_FORMAT_RGB565
LTDC.VBP=20
LTDC.VFP=10
LTDC.VSync=3
LTDC.WindowX1_L0=0
LTDC.WindowX1_L1=0
LTDC.WindowY1_L0=0
LTDC.WindowY1_L1=0
Mcu.Family=STM32F4
Mcu.Name=STM32F429I(E-G-I)Hx
Mcu.Package=UFBGA176
NVIC.ADC_IRQn=true\:7\:0\:true\:false\:true\:true\:true\:true
NVIC.DMA2D_IRQn=true\:7\:0\:true\:false\:true\:true\:true\:true
NVIC.DMA2_Stream5_IRQn=true\:7\:0\:true\:false\:true\:true\:true\:true
NVIC.DMA2_Stream7_IRQn=true\:7\:0\:true\:false\:true\:true\:false\:true
NVIC.EXTI3_IRQn=true\:0\:0\:true\:false\:true\:false\:true\:true
NVIC.FLASH_IRQn=true\:0\:0\:true\:false\:false\:false\:true\:true
NVIC.FMC_IRQn=true\:5\:0\:true\:false\:true\:true\:true\:true
NVIC.LTDC_ER_IRQn=true\:7\:0\:true\:false\:true\:true\:true\:true
NVIC.LTDC_IRQn=true\:7\:0\:true\:false\:true\:true\:true\:true
NVIC.OTG_FS_IRQn=true\:5\:0\:true\:false\:true\:true\:false\:true
NVIC.OTG_HS_IRQn=true\:5\:0\:true\:false\:true\:true\:false\:true
NVIC.PriorityGroup=NVIC_PRIORITYGROUP_4
NVIC.RCC_IRQn=true\:0\:0\:true\:false\:false\:false\:true\:false
NVIC.SPI5_IRQn=true\:7\:0\:true\:false\:true\:true\:true\:true
NVIC.TIM1_TRG_COM_TIM11_IRQn=true\:7\:0\:true\:false\:true\:true\:true\:true
NVIC.TIM1_UP_TIM10_IRQn=true\:0\:0\:true\:false\:true\:false\:false\:true
NVIC.TIM2_IRQn=true\:7\:0\:true\:false\:true\:true\:true\:true
NVIC.TIM3_IRQn=true\:7\:0\:true\:false\:true\:true\:true\:true
NVIC.TIM4_IRQn=true\:0\:0\:true\:false\:true\:false\:true\:true
NVIC.TimeBase=TIM1_UP_TIM10_IRQn
NVIC.TimeBaseIP=TIM1
NVIC.USART1_IRQn=true\:7\:0\:true\:false\:true\:true\:true\:true
PA0/WKUP.GPIO_Label=GD32_TEMP_B
PA0/WKUP.Signal=ADCx_IN0
PA1.GPIO_Label=GD32_HEAT_NOZ_E
PA1.Signal=GPIO_Output
PA10.Mode=Asynchronous
PA10.Signal=USART1_RX
PA11.GPIO_PuPd=GPIO_PULLUP
PA11.GPIO_Speed=GPIO_SPEED_FREQ_MEDIUM
PA11.Mode=Host_Only
PA11.Signal=USB_OTG_FS_DM
PA12.GPIO_PuPd=GPIO_PULLUP
PA12.GPIO_Speed=GPIO_SPEED_FREQ_MEDIUM
PA12.Mode=Host_Only
PA12.Signal=USB_OTG_FS_DP
PA13.Mode=Serial_Wire
PA13.Signal=SYS_JTMS-SWDIO
PA14.Mode=Serial_Wire
PA14.Signal=SYS_JTCK-SWCLK
PA15.GPIO_Label=GD32_FAN_NOZ_B
PA15.Signal=S_TIM2_CH1_ETR
PA2.GPIO_Label=GD32_HEAT_NOZ_B
PA2.Signal=GPIO_Output
PA3.GPIO_Label=GD32_TEMP_E
PA3.Signal=ADCx_IN3
PA4.GPIO_Label=GD32_Z_CS
PA4.Signal=GPIO_Output
PA5.GPIO_Label=GD32_SIG_MAT_E0
PA5.GPIO_PuPd=GPIO_PULLUP
PA5.Signal=GPIO_Input
PA6.GPIO_Label=GD32_TEMP_BED
PA6.Signal=ADCx_IN6
PA7.GPIO_Label=GD32_SIG_X2
PA7.GPIO_PuPd=GPIO_PULLUP
PA7.Signal=GPIO_Input
PA8.GPIO_Label=GD32_FAN_EB_MOTOR
PA8.Signal=GPIO_Output
PA9.Mode=Asynchronous
PA9.Signal=USART1_TX
PB0.GPIO_Label=GD32_HEAT_CAVITY
PB0.Signal=GPIO_Output
PB1.GPIO_Label=GD32_TEMP_CAVITY
PB1.Signal=ADCx_IN9
PB10.GPIO_Label=GD32_Y_DIR
PB10.Signal=GPIO_Output
PB12.GPIO_Label=GD32_Y_STP
PB12.Signal=GPIO_Output
PB13.GPIO_Label=GD32_SIG_Y
PB13.GPIO_PuPd=GPIO_PULLUP
PB13.Signal=GPIO_Input
PB14.GPIO_Speed=GPIO_SPEED_FREQ_VERY_HIGH
PB14.Mode=Device_Only_FS
PB14.Signal=USB_OTG_HS_DM
PB15.GPIO_Speed=GPIO_SPEED_FREQ_VERY_HIGH
PB15.Mode=Device_Only_FS
PB15.Signal=USB_OTG_HS_DP
PB2/BOOT1.GPIO_Label=GD32_LIGHT
PB2/BOOT1.Signal=GPIO_Output
PB3.GPIO_Label=GD32_FAN_NOZ_E
PB3.Signal=S_TIM2_CH2
PB4.GPIO_Label=GD32_B_DIR
PB4.Signal=GPIO_Output
PB5.GPIO_Label=GD32_LCD_BACKLIGHT
PB5.GPIO_PuPd=GPIO_PULLUP
PB5.GPIO_Speed=GPIO_SPEED_FREQ_VERY_HIGH
PB5.Signal=GPIO_Output
PB6.GPIO_Label=GD32_X2_DIR
PB6.Signal=GPIO_Output
PB7.GPIO_Label=GD32_X2_STP
PB7.Signal=GPIO_Output
PB8.GPIO_Label=GD32_SIG_SD_DETECT
PB8.GPIO_PuPd=GPIO_PULLUP
PB8.Signal=GPIO_Input
PB9.GPIO_Label=GD32_BUZZER
PB9.GPIO_PuPd=GPIO_PULLUP
PB9.Signal=S_TIM11_CH1
PC0.GPIO_Speed_High_Default=GPIO_SPEED_FREQ_HIGH
PC0.Signal=FMC_SDNWE
PC1.GPIO_Label=GD32_Y_CS
PC1.Signal=GPIO_Output
PC10.Signal=GPIO_Output
PC11.Signal=GPIO_Output
PC13.GPIO_Label=GD32_LIGHT_BAR
PC13.Signal=GPIO_Output
PC14/OSC32_IN.GPIO_Label=GD32_SIG_Z_MAX
PC14/OSC32_IN.GPIO_PuPd=GPIO_PULLUP
PC14/OSC32_IN.Signal=GPIO_Input
PC15/OSC32_OUT.GPIO_Label=GD32_SIG_Z_MIN
PC15/OSC32_OUT.GPIO_PuPd=GPIO_PULLUP
PC15/OSC32_OUT.Signal=GPIO_Input
PC2.GPIO_Speed_High_Default=GPIO_SPEED_FREQ_HIGH
PC2.Mode=SdramChipSelect1_1
PC2.Signal=FMC_SDNE0
PC3.GPIO_Speed_High_Default=GPIO_SPEED_FREQ_HIGH
PC3.Mode=SdramChipSelect1_1
PC3.Signal=FMC_SDCKE0
PC4.GPIO_Label=GD32_E_CS
PC4.Signal=GPIO_Output
PC5.GPIO_Label=GD32_B_CS
PC5.Signal=GPIO_Output
PC6.GPIO_Label=GD32_SIG_MAT_E1
PC6.GPIO_PuPd=GPIO_PULLUP
PC6.Signal=GPIO_Input
PC7.GPIO_Label=GD32_Z_EN
PC7.Signal=GPIO_Output
PD0.GPIO_Speed_High_Default=GPIO_SPEED_FREQ_HIGH
PD0.Signal=FMC_D2_DA2
PD1.GPIO_Speed_High_Default=GPIO_SPEED_FREQ_HIGH
PD1.Signal=FMC_D3_DA3
PD10.GPIO_Speed_High_Default=GPIO_SPEED_FREQ_HIGH
PD10.Signal=FMC_D15_DA15
PD11.GPIO_Speed_High_Default=GPIO_SPEED_FREQ_HIGH
PD11.Signal=FMC_A16_CLE
PD12.GPIO_Speed_High_Default=GPIO_SPEED_FREQ_HIGH
PD12.Signal=FMC_A17_ALE
PD13.GPIO_Label=GD32_FAN_FILTER
PD13.Signal=GPIO_Output
PD14.GPIO_Speed_High_Default=GPIO_SPEED_FREQ_HIGH
PD14.Signal=FMC_D0_DA0
PD15.GPIO_Speed_High_Default=GPIO_SPEED_FREQ_HIGH
PD15.Signal=FMC_D1_DA1
PD2.Signal=GPIO_Output
PD3.GPIO_Label=GD32_B_STP
PD3.Signal=GPIO_Output
PD4.GPIO_Speed_High_Default=GPIO_SPEED_FREQ_HIGH
PD4.Signal=FMC_NOE
PD5.GPIO_Speed_High_Default=GPIO_SPEED_FREQ_HIGH
PD5.Signal=FMC_NWE
PD6.GPIO_Label=GD32_E_STP
PD6.Signal=GPIO_Output
PD7.GPIO_Label=GD32_Y_EN
PD7.Signal=GPIO_Output
PD8.GPIO_Speed_High_Default=GPIO_SPEED_FREQ_HIGH
PD8.Signal=FMC_D13_DA13
PD9.GPIO_Speed_High_Default=GPIO_SPEED_FREQ_HIGH
PD9.Signal=FMC_D14_DA14
PE0.GPIO_Speed_High_Default=GPIO_SPEED_FREQ_HIGH
PE0.Signal=FMC_NBL0
PE1.GPIO_Speed_High_Default=GPIO_SPEED_FREQ_HIGH
PE1.Signal=FMC_NBL1
PE10.GPIO_Speed_High_Default=GPIO_SPEED_FREQ_HIGH
PE10.Signal=FMC_D7_DA7
PE11.GPIO_Speed_High_Default=GPIO_SPEED_FREQ_HIGH
PE11.Signal=FMC_D8_DA8
PE12.GPIO_Speed_High_Default=GPIO_SPEED_FREQ_HIGH
PE12.Signal=FMC_D9_DA9
PE13.GPIO_Speed_High_Default=GPIO_SPEED_FREQ_HIGH
PE13.Signal=FMC_D10_DA10
PE14.GPIO_Speed_High_Default=GPIO_SPEED_FREQ_HIGH
PE14.Signal=FMC_D11_DA11
PE15.GPIO_Speed_High_Default=GPIO_SPEED_FREQ_HIGH
PE15.Signal=FMC_D12_DA12
PE2.GPIO_Label=GD32_X_CS
PE2.Signal=GPIO_Output
PE3.GPIO_PuPd=GPIO_PULLUP
PE3.Signal=GPXTI3
PE4.GPIO_Label=GD32_SIG_DOOR
PE4.GPIO_PuPd=GPIO_PULLUP
PE4.Signal=GPIO_Input
PE5.GPIO_Label=GD32_HEAT_BED
PE5.Signal=GPIO_Output
PE6.GPIO_Label=GD32_Z_DIR
PE6.Signal=GPIO_Output
PE7.GPIO_Speed_High_Default=GPIO_SPEED_FREQ_HIGH
PE7.Signal=FMC_D4_DA4
PE8.GPIO_Speed_High_Default=GPIO_SPEED_FREQ_HIGH
PE8.Signal=FMC_D5_DA5
PE9.GPIO_Speed_High_Default=GPIO_SPEED_FREQ_HIGH
PE9.Signal=FMC_D6_DA6
PF0.GPIO_Speed_High_Default=GPIO_SPEED_FREQ_HIGH
PF0.Signal=FMC_A0
PF1.GPIO_Speed_High_Default=GPIO_SPEED_FREQ_HIGH
PF1.Signal=FMC_A1
PF10.GPIO_PuPd=GPIO_NOPULL
PF10.GPIO_Speed=GPIO_SPEED_FREQ_HIGH
PF10.Mode=RGB565
PF10.Signal=LTDC_DE
PF11.GPIO_Speed_High_Default=GPIO_SPEED_FREQ_HIGH
PF11.Signal=FMC_SDNRAS
PF12.GPIO_Speed_High_Default=GPIO_SPEED_FREQ_HIGH
PF12.Signal=FMC_A6
PF13.GPIO_Speed_High_Default=GPIO_SPEED_FREQ_HIGH
PF13.Signal=FMC_A7
PF14.GPIO_Speed_High_Default=GPIO_SPEED_FREQ_HIGH
PF14.Signal=FMC_A8
PF15.GPIO_Speed_High_Default=GPIO_SPEED_FREQ_HIGH
PF15.Signal=FMC_A9
PF2.GPIO_Speed_High_Default=GPIO_SPEED_FREQ_HIGH
PF2.Signal=FMC_A2
PF3.GPIO_Speed_High_Default=GPIO_SPEED_FREQ_HIGH
PF3.Signal=FMC_A3
PF4.GPIO_Speed_High_Default=GPIO_SPEED_FREQ_HIGH
PF4.Signal=FMC_A4
PF5.GPIO_Speed_High_Default=GPIO_SPEED_FREQ_HIGH
PF5.Signal=FMC_A5
PF6.GPIO_Label=GD32_STEERING_ENGINE
PF6.Signal=S_TIM10_CH1
PF7.Mode=Full_Duplex_Master
PF7.Signal=SPI5_SCK
PF8.Mode=Full_Duplex_Master
PF8.Signal=SPI5_MISO
PF9.Mode=Full_Duplex_Master
PF9.Signal=SPI5_MOSI
PG0.GPIO_Speed_High_Default=GPIO_SPEED_FREQ_HIGH
PG0.Signal=FMC_A10
PG1.GPIO_Speed_High_Default=GPIO_SPEED_FREQ_HIGH
PG1.Signal=FMC_A11
PG10.GPIO_Label=GD32_B_EN
PG10.Signal=GPIO_Output
PG11.GPIO_PuPd=GPIO_NOPULL
PG11.GPIO_Speed=GPIO_SPEED_FREQ_HIGH
PG11.Mode=RGB565
PG11.Signal=LTDC_B3
PG12.GPIO_Label=GD32_E_EN
PG12.Signal=GPIO_Output
PG13.GPIO_Label=GD32_Z_STP
PG13.Signal=GPIO_Output
PG14.GPIO_Label=GD32_X2_EN
PG14.Signal=GPIO_Output
PG15.GPIO_Speed_High_Default=GPIO_SPEED_FREQ_HIGH
PG15.Signal=FMC_SDNCAS
PG2.GPIO_Speed_High_Default=GPIO_SPEED_FREQ_HIGH
PG2.Signal=FMC_A12
PG3.GPIO_Label=GD32_TOUCH_MISO
PG3.Signal=GPIO_Output
PG4.GPIO_Speed_High_Default=GPIO_SPEED_FREQ_HIGH
PG4.Signal=FMC_A14_BA0
PG5.GPIO_Speed_High_Default=GPIO_SPEED_FREQ_HIGH
PG5.Signal=FMC_A15_BA1
PG6.GPIO_PuPd=GPIO_NOPULL
PG6.GPIO_Speed=GPIO_SPEED_FREQ_HIGH
PG6.Mode=RGB565
PG6.Signal=LTDC_R7
PG7.GPIO_PuPd=GPIO_NOPULL
PG7.GPIO_Speed=GPIO_SPEED_FREQ_HIGH
PG7.Mode=RGB565
PG7.Signal=LTDC_CLK
PG8.GPIO_Speed_High_Default=GPIO_SPEED_FREQ_HIGH
PG8.Signal=FMC_SDCLK
PG9.GPIO_Speed_High_Default=GPIO_SPEED_FREQ_HIGH
PG9.Mode=NandChipSelect3_1
PG9.Signal=FMC_NCE3
PH0/OSC_IN.Mode=HSE-External-Oscillator
PH0/OSC_IN.Signal=RCC_OSC_IN
PH1/OSC_OUT.Mode=HSE-External-Oscillator
PH1/OSC_OUT.Signal=RCC_OSC_OUT
PH10.GPIO_PuPd=GPIO_NOPULL
PH10.GPIO_Speed=GPIO_SPEED_FREQ_HIGH
PH10.Mode=RGB565
PH10.Signal=LTDC_R4
PH11.GPIO_PuPd=GPIO_NOPULL
PH11.GPIO_Speed=GPIO_SPEED_FREQ_HIGH
PH11.Mode=RGB565
PH11.Signal=LTDC_R5
PH12.GPIO_PuPd=GPIO_NOPULL
PH12.GPIO_Speed=GPIO_SPEED_FREQ_HIGH
PH12.Mode=RGB565
PH12.Signal=LTDC_R6
PH13.GPIO_PuPd=GPIO_NOPULL
PH13.GPIO_Speed=GPIO_SPEED_FREQ_HIGH
PH13.Mode=RGB565
PH13.Signal=LTDC_G2
PH14.GPIO_PuPd=GPIO_NOPULL
PH14.GPIO_Speed=GPIO_SPEED_FREQ_HIGH
PH14.Mode=RGB565
PH14.Signal=LTDC_G3
PH15.GPIO_PuPd=GPIO_NOPULL
PH15.GPIO_Speed=GPIO_SPEED_FREQ_HIGH
PH15.Mode=RGB565
PH15.Signal=LTDC_G4
PH2.GPIO_Label=GD32_SIG_X
PH2.GPIO_PuPd=GPIO_PULLUP
PH2.Signal=GPIO_Input
PH3.GPIO_Label=GD32_X_STP
PH3.Signal=GPIO_Output
PH4.GPIO_Label=GD32_X_DIR
PH4.Signal=GPIO_Output
PH5.GPIO_Label=GD32_X_EN
PH5.Signal=GPIO_Output
PH6.GPIO_Label=GD32_TOUCH_SCK
PH6.Signal=GPIO_Output
PH7.GPIO_Label=GD32_TOUCH_PEN
PH7.Signal=GPIO_Output
PH8.GPIO_Label=GD32_E_DIR
PH8.Signal=GPIO_Output
PH9.GPIO_PuPd=GPIO_NOPULL
PH9.GPIO_Speed=GPIO_SPEED_FREQ_HIGH
PH9.Mode=RGB565
PH9.Signal=LTDC_R3
PI0.GPIO_PuPd=GPIO_NOPULL
PI0.GPIO_Speed=GPIO_SPEED_FREQ_HIGH
PI0.Mode=RGB565
PI0.Signal=LTDC_G5
PI1.GPIO_PuPd=GPIO_NOPULL
PI1.GPIO_Speed=GPIO_SPEED_FREQ_HIGH
PI1.Mode=RGB565
PI1.Signal=LTDC_G6
PI10.GPIO_PuPd=GPIO_NOPULL
PI10.GPIO_Speed=GPIO_SPEED_FREQ_HIGH
PI10.Mode=RGB565
PI10.Signal=LTDC_HSYNC
PI11.GPIO_Label=GD32_X2_CS
PI11.Signal=GPIO_Output
PI2.GPIO_PuPd=GPIO_NOPULL
PI2.GPIO_Speed=GPIO_SPEED_FREQ_HIGH
PI2.Mode=RGB565
PI2.Signal=LTDC_G7
PI3.GPIO_Label=GD32_TOUCH_MOSI
PI3.Signal=GPIO_Output
PI4.GPIO_PuPd=GPIO_NOPULL
PI4.GPIO_Speed=GPIO_SPEED_FREQ_HIGH
PI4.Mode=RGB565
PI4.Signal=LTDC_B4
PI5.GPIO_PuPd=GPIO_NOPULL
PI5.GPIO_Speed=GPIO_SPEED_FREQ_HIGH
PI5.Mode=RGB565
PI5.Signal=LTDC_B5
PI6.GPIO_PuPd=GPIO_NOPULL
PI6.GPIO_Speed=GPIO_SPEED_FREQ_HIGH
PI6.Mode=RGB565
PI6.Signal=LTDC_B6
PI7.GPIO_PuPd=GPIO_NOPULL
PI7.GPIO_Speed=GPIO_SPEED_FREQ_HIGH
PI7.Mode=RGB565
PI7.Signal=LTDC_B7
PI8.GPIO_Label=GD32_TOUCH_CS
PI8.Signal=GPIO_Output
PI9.GPIO_PuPd=GPIO_NOPULL
PI9.GPIO_Speed=GPIO_SPEED_FREQ_HIGH
PI9.Mode=RGB565
PI9.Signal=LTDC_VSYNC
ProjectManager.HeapSize=0x2000
ProjectManager.StackSize=0x2000
ProjectManager.TargetToolchain=MDK-ARM V5.27
RCC.48MHZClocksFreq_Value=48000000
RCC.AHBFreq_Value=168000000
RCC.APB1CLKDivider=RCC_HCLK_DIV4
RCC.APB1Freq_Value=42000000
RCC.APB1TimFreq_Value=84000000
RCC.APB2CLKDivider=RCC_HCLK_DIV2
RCC.APB2Freq_Value=84000000
RCC.APB2TimFreq_Value=168000000
RCC.CortexFreq_Value=21000000
RCC.Cortex_Div=SYSTICK_CLKSOURCE_HCLK_DIV8
RCC.HCLKFreq_Value=168000000
RCC.HSE_Timout=0xFFFF
RCC.HSE_VALUE=25000000
RCC.HSI_VALUE=16000000
RCC.LSE_VALUE=32768
RCC.PLLM=25
RCC.PLLN=336
RCC.PLLQ=7
RCC.PLLSAIN=100
RCC.SYSCLKFreq_VALUE=168000000
RCC.SYSCLKSource=RCC_SYSCLKSOURCE_PLLCLK
RCC.VCOOutputFreq_Value=336000000
SH.ADCx_IN0.0=ADC1_IN0,IN0
SH.ADCx_IN3.0=ADC1_IN3,IN3
SH.ADCx_IN6.0=ADC1_IN6,IN6
SH.ADCx_IN9.0=ADC1_IN9,IN9
SH.FMC_A0.0=FMC_A0,13b-sda1
SH.FMC_A1.0=FMC_A1,13b-sda1
SH.FMC_A10.0=FMC_A10,13b-sda1
SH.FMC_A11.0=FMC_A11,13b-sda1
SH.FMC_A12.0=FMC_A12,13b-sda1
SH.FMC_A14_BA0.0=FMC_BA0,FourSdramBanks1
SH.FMC_A15_BA1.0=FMC_BA1,FourSdramBanks1
SH.FMC_A16_CLE.0=FMC_CLE,8b-dmux1
SH.FMC_A17_ALE.0=FMC_ALE,8b-dmux1
SH.FMC_A2.0=FMC_A2,13b-sda1
SH.FMC_A3.0=FMC_A3,13b-sda1
SH.FMC_A4.0=FMC_A4,13b-sda1
SH.FMC_A5.0=FMC_A5,13b-sda1
SH.FMC_A6.0=FMC_A6,13b-sda1
SH.FMC_A7.0=FMC_A7,13b-sda1
SH.FMC_A8.0=FMC_A8,13b-sda1
SH.FMC_A9.0=FMC_A9,13b-sda1
SH.FMC_D0_DA0.0=FMC_D0,8b-dmux1
SH.FMC_D0_DA0.1=FMC_D0,sd-16b-d1
SH.FMC_D10_DA10.0=FMC_D10,sd-16b-d1
SH.FMC_D11_DA11.0=FMC_D11,sd-16b-d1
SH.FMC_D12_DA12.0=FMC_D12,sd-16b-d1
SH.FMC_D13_DA13.0=FMC_D13,sd-16b-d1
SH.FMC_D14_DA14.0=FMC_D14,sd-16b-d1
SH.FMC_D15_DA15.0=FMC_D15,sd-16b-d1
SH.FMC_D1_DA1.0=FMC_D1,8b-dmux1
SH.FMC_D1_DA1.1=FMC_D1,sd-16b-d1
SH.FMC_D2_DA2.0=FMC_D2,8b-dmux1
SH.FMC_D2_DA2.1=FMC_D2,sd-16b-d1
SH.FMC_D3_DA3.0=FMC_D3,8b-dmux1
SH.FMC_D3_DA3.1=FMC_D3,sd-16b-d1
SH.FMC_D4_DA4.0=FMC_D4,8b-dmux1
SH.FMC_D4_DA4.1=FMC_D4,sd-16b-d1
SH.FMC_D5_DA5.0=FMC_D5,8b-dmux1
SH.FMC_D5_DA5.1=FMC_D5,sd-16b-d1
SH.FMC_D6_DA6.0=FMC_D6,8b-dmux1
SH.FMC_D6_DA6.1=FMC_D6,sd-16b-d1
SH.FMC_D7_DA7.0=FMC_D7,8b-dmux1
SH.FMC_D7_DA7.1=FMC_D7,sd-16b-d1
SH.FMC_D8_DA8.0=FMC_D8,sd-16b-d1
SH.FMC_D9_DA9.0=FMC_D9,sd-16b-d1
SH.FMC_NBL0.0=FMC_NBL0,Sd2ByteEnable1
SH.FMC_NBL1.0=FMC_NBL1,Sd2ByteEnable1
SH.FMC_NOE.0=FMC_NOE,8b-dmux1
SH.FMC_NWE.0=FMC_NWE,8b-dmux1
SH.FMC_SDCLK.0=FMC_SDCLK,13b-sda1
SH.FMC_SDNCAS.0=FMC_SDNCAS,13b-sda1
SH.FMC_SDNRAS.0=FMC_SDNRAS,13b-sda1
SH.FMC_SDNWE.0=FMC_SDNWE,13b-sda1
SH.S_TIM10_CH1.0=TIM10_CH1,PWM Generation1 CH1
SH.S_TIM11_CH1.0=TIM11_CH1,PWM Generation1 CH1
SH.S_TIM2_CH1_ETR.0=TIM2_CH1,PWM Generation1 CH1
SH.S_TIM2_CH2.0=TIM2_CH2,PWM Generation2 CH2
SPI5.CalculateBaudRate=42.0 MBits/s
SPI5.Direction=SPI_DIRECTION_2LINES
SPI5.Mode=SPI_MODE_MASTER
SPI5.VirtualType=VM_MASTER
STMicroelectronics.X-CUBE-ALGOBUILD.1.3.0.LibraryCcDSPOoLibraryJjDSPOoLibrary=true
TIM10.Channel=TIM_CHANNEL_1
TIM10.Period=99
TIM10.Prescaler=167
TIM10.Pulse=2120
TIM11.Channel=TIM_CHANNEL_1
TIM11.OCPolarity_1=TIM_OCPOLARITY_LOW
TIM11.Period=999
TIM11.Prescaler=83
TIM2.Channel-PWM\ Generation1\ CH1=TIM_CHANNEL_1
TIM2.Channel-PWM\ Generation2\ CH2=TIM_CHANNEL_2
TIM2.OCMode_PWM-PWM\ Generation2\ CH2=TIM_OCMODE_PWM2
TIM2.OCPolarity_1=TIM_OCPOLARITY_HIGH
TIM2.OCPolarity_2=TIM_OCPOLARITY_LOW
TIM2.Period=99
TIM2.Prescaler=83
TIM2.Pulse-PWM\ Generation1\ CH1=2120
TIM2.Pulse-PWM\ Generation2\ CH2=2120
TIM3.Period=999
TIM3.Prescaler=83
TIM4.Period=16383
TIM4.Prescaler=41
USART1.VirtualMode=VM_ASYNC
USB_DEVICE.CLASS_NAME_HS=CDC
USB_DEVICE.MANUFACTURER_STRING-CDC_HS=MakerPi
USB_DEVICE.PID_CDC_HS=22288
USB_DEVICE.PRODUCT_STRING_CDC_HS=3D Print
USB_DEVICE.VirtualMode-CDC_HS=Cdc
USB_DEVICE.VirtualModeHS=Cdc_HS
USB_HOST.USBH_DEBUG_LEVEL-MSC_FS=0
USB_HOST.USBH_HandleTypeDef-MSC_FS=hUsbHostFS
USB_HOST.USBH_MAX_DATA_BUFFER-MSC_FS=512
USB_HOST.USBH_MAX_NUM_ENDPOINTS-MSC_FS=2
USB_HOST.USBH_MAX_SIZE_CONFIGURATION-MSC_FS=512
USB_HOST.USBH_PROCESS_PRIO-MSC_FS=osPriorityHigh
USB_HOST.USBH_PROCESS_STACK_SIZE-MSC_FS=512
USB_HOST.USBH_USE_OS-MSC_FS=0
USB_HOST.VirtualModeFS=Msc
USB_OTG_FS.VirtualMode=Host_Only
USB_OTG_FS.phy_itface=HCD_PHY_EMBEDDED
USB_OTG_HS.Sof_enable-Device_Only_FS=DISABLE
USB_OTG_HS.VirtualMode-Device_Only_FS=Device_Only_FS
USB_OTG_HS.dma_enable-Device_Only_FS=ENABLE
USB_OTG_HS.low_power_enable-Device_Only_FS=DISABLE
USB_OTG_HS.lpm_enable-Device_Only_FS=DISABLE
USB_OTG_HS.use_dedicated_ep1-Device_Only_FS=DISABLE
VP_CRC_VS_CRC.Mode=CRC_Activate
VP_DMA2D_VS_DMA2D.Mode=DMA2D_Activate
VP_FATFS_VS_Generic.Mode=User_defined
VP_FATFS_VS_USB.Mode=USB
VP_FREERTOS_VS_CMSIS_V1.Mode=CMSIS_V1
VP_IWDG_VS_IWDG.Mode=IWDG_Activate
VP_STMicroelectronics.X-CUBE-ALGOBUILD_VS_DSPOoLibraryJjLibrary_1.3.0_1.3.0.Mode=DSPOoLibraryJjLibrary
VP_SYS_VS_tim1.Mode=TIM1
VP_TIM10_VS_ClockSourceINT.Mode=Enable_Timer
VP_TIM10_VS_OPM.Mode=OPM_bit
VP_TIM11_VS_ClockSourceINT.Mode=Enable_Timer
VP_TIM2_VS_ClockSourceINT.Mode=Internal
VP_TIM3_VS_ClockSourceINT.Mode=Internal
VP_TIM4_VS_ClockSourceINT.Mode=Internal
VP_USB_DEVICE_VS_USB_DEVICE_CDC_HS.Mode=CDC_HS
VP_USB_HOST_VS_USB_HOST_MSC_FS.Mode=MSC_FS
board=custom

// file: Core/Src/main.c
/* USER CODE BEGIN Header */
/**
  ******************************************************************************
  * @file           : main.c
  * @brief          : Main program body
  ******************************************************************************
  * @attention
  *
  * <h2><center>&copy; Copyright (c) 2022 STMicroelectronics.
  * All rights reserved.</center></h2>
  *
  * This software component is licensed by ST under Ultimate Liberty license
  * SLA0044, the "License"; You may not use this file except in compliance with
  * the License. You may obtain a copy of the License at:
  *                             www.st.com/SLA0044
  *
  ******************************************************************************
  */
/* USER CODE END Header */
#include "main.h"
#include "cmsis_os.h"
#include "fatfs.h"
#include "usb_device.h"
#include "usb_host.h"

ADC_HandleTypeDef hadc1;

CRC_HandleTypeDef hcrc;

DMA2D_HandleTypeDef hdma2d;

IWDG_HandleTypeDef hiwdg;

LTDC_HandleTypeDef hltdc;

SPI_HandleTypeDef hspi5;

TIM_HandleTypeDef htim2;
TIM_HandleTypeDef htim3;
TIM_HandleTypeDef htim4;
TIM_HandleTypeDef htim10;
TIM_HandleTypeDef htim11;

UART_HandleTypeDef huart1;
DMA_HandleTypeDef hdma_usart1_rx;
DMA_HandleTypeDef hdma_usart1_tx;

NAND_HandleTypeDef hnand1;
SDRAM_HandleTypeDef hsdram1;

osThreadId InitTaskHandle;
osThreadId RefDataTaskHandle;
osThreadId ReadUdiskTaskHandle;
osThreadId PrintTaskHandle;
osThreadId GUITaskHandle;
osThreadId RespondGUITaskHandle;
osMessageQId GcodeCommandHandle;
osSemaphoreId GUISendSemHandle;
osSemaphoreId GUIWaitSemHandle;
osSemaphoreId ReadUdiskSemHandle;
osSemaphoreId ReceiveUartCmdHandle;

void SystemClock_Config(void);
static void MX_GPIO_Init(void);
static void MX_DMA_Init(void);
static void MX_ADC1_Init(void);
static void MX_DMA2D_Init(void);
static void MX_FMC_Init(void);
static void MX_LTDC_Init(void);
static void MX_SPI5_Init(void);
static void MX_USART1_UART_Init(void);
static void MX_CRC_Init(void);
static void MX_IWDG_Init(void);
static void MX_TIM2_Init(void);
static void MX_TIM3_Init(void);
static void MX_TIM4_Init(void);
static void MX_TIM11_Init(void);
static void MX_TIM10_Init(void);
void InitTask_OS(void const * argument);
void RefDataTask_OS(void const * argument);
void ReadUdiskTask_OS(void const * argument);
void PrintTask_OS(void const * argument);
void GUITask_OS(void const * argument);
void RespondGUITask_OS(void const * argument);

int main(void)
{

  /* MCU Configuration--------------------------------------------------------*/

  /* Reset of all peripherals, Initializes the Flash interface and the Systick. */
  HAL_Init();

  /* Configure the system clock */
  SystemClock_Config();

  /* Initialize all configured peripherals */
  MX_GPIO_Init();
  MX_DMA_Init();
  MX_ADC1_Init();
  MX_DMA2D_Init();
  MX_FMC_Init();
  MX_LTDC_Init();
  MX_SPI5_Init();
  MX_USART1_UART_Init();
  MX_CRC_Init();
  MX_IWDG_Init();
  MX_TIM2_Init();
  MX_TIM3_Init();
  MX_TIM4_Init();
  MX_TIM11_Init();
  MX_FATFS_Init();
  MX_TIM10_Init();

  /* Create the semaphores(s) */
  /* definition and creation of GUISendSem */
  osSemaphoreDef(GUISendSem);
  GUISendSemHandle = osSemaphoreCreate(osSemaphore(GUISendSem), 2);

  /* definition and creation of GUIWaitSem */
  osSemaphoreDef(GUIWaitSem);
  GUIWaitSemHandle = osSemaphoreCreate(osSemaphore(GUIWaitSem), 2);

  /* definition and creation of ReadUdiskSem */
  osSemaphoreDef(ReadUdiskSem);
  ReadUdiskSemHandle = osSemaphoreCreate(osSemaphore(ReadUdiskSem), 2);

  /* definition and creation of ReceiveUartCmd */
  osSemaphoreDef(ReceiveUartCmd);
  ReceiveUartCmdHandle = osSemaphoreCreate(osSemaphore(ReceiveUartCmd), 2);

  /* Create the queue(s) */
  /* definition and creation of GcodeCommand */
  osMessageQDef(GcodeCommand, 64, uint32_t);
  GcodeCommandHandle = osMessageCreate(osMessageQ(GcodeCommand), NULL);

  /* Create the thread(s) */
  /* definition and creation of InitTask */
  osThreadDef(InitTask, InitTask_OS, osPriorityRealtime, 0, 512);
  InitTaskHandle = osThreadCreate(osThread(InitTask), NULL);

  /* definition and creation of RefDataTask */
  osThreadDef(RefDataTask, RefDataTask_OS, osPriorityHigh, 0, 1024);
  RefDataTaskHandle = osThreadCreate(osThread(RefDataTask), NULL);

  /* definition and creation of ReadUdiskTask */
  osThreadDef(ReadUdiskTask, ReadUdiskTask_OS, osPriorityHigh, 0, 512);
  ReadUdiskTaskHandle = osThreadCreate(osThread(ReadUdiskTask), NULL);

  /* definition and creation of PrintTask */
  osThreadDef(PrintTask, PrintTask_OS, osPriorityHigh, 0, 1536);
  PrintTaskHandle = osThreadCreate(osThread(PrintTask), NULL);

  /* definition and creation of GUITask */
  osThreadDef(GUITask, GUITask_OS, osPriorityHigh, 0, 1024);
  GUITaskHandle = osThreadCreate(osThread(GUITask), NULL);

  /* definition and creation of RespondGUITask */
  osThreadDef(RespondGUITask, RespondGUITask_OS, osPriorityNormal, 0, 512);
  RespondGUITaskHandle = osThreadCreate(osThread(RespondGUITask), NULL);

  /* Start scheduler */
  osKernelStart();

  /* We should never get here as control is now taken by the scheduler */
  /* Infinite loop */
  while (1)
  {

  }
}

void SystemClock_Config(void)
{
  RCC_OscInitTypeDef RCC_OscInitStruct = {0};
  RCC_ClkInitTypeDef RCC_ClkInitStruct = {0};
  RCC_PeriphCLKInitTypeDef PeriphClkInitStruct = {0};

  /** Configure the main internal regulator output voltage
  */
  __HAL_RCC_PWR_CLK_ENABLE();
  __HAL_PWR_VOLTAGESCALING_CONFIG(PWR_REGULATOR_VOLTAGE_SCALE1);
  /** Initializes the RCC Oscillators according to the specified parameters
  * in the RCC_OscInitTypeDef structure.
  */
  RCC_OscInitStruct.OscillatorType = RCC_OSCILLATORTYPE_LSI|RCC_OSCILLATORTYPE_HSE;
  RCC_OscInitStruct.HSEState = RCC_HSE_ON;
  RCC_OscInitStruct.LSIState = RCC_LSI_ON;
  RCC_OscInitStruct.PLL.PLLState = RCC_PLL_ON;
  RCC_OscInitStruct.PLL.PLLSource = RCC_PLLSOURCE_HSE;
  RCC_OscInitStruct.PLL.PLLM = 25;
  RCC_OscInitStruct.PLL.PLLN = 336;
  RCC_OscInitStruct.PLL.PLLP = RCC_PLLP_DIV2;
  RCC_OscInitStruct.PLL.PLLQ = 7;
  if (HAL_RCC_OscConfig(&RCC_OscInitStruct) != HAL_OK)
  {
    Error_Handler();
  }
  /** Initializes the CPU, AHB and APB buses clocks
  */
  RCC_ClkInitStruct.ClockType = RCC_CLOCKTYPE_HCLK|RCC_CLOCKTYPE_SYSCLK
                              |RCC_CLOCKTYPE_PCLK1|RCC_CLOCKTYPE_PCLK2;
  RCC_ClkInitStruct.SYSCLKSource = RCC_SYSCLKSOURCE_PLLCLK;
  RCC_ClkInitStruct.AHBCLKDivider = RCC_SYSCLK_DIV1;
  RCC_ClkInitStruct.APB1CLKDivider = RCC_HCLK_DIV4;
  RCC_ClkInitStruct.APB2CLKDivider = RCC_HCLK_DIV2;

  if (HAL_RCC_ClockConfig(&RCC_ClkInitStruct, FLASH_LATENCY_5) != HAL_OK)
  {
    Error_Handler();
  }
  PeriphClkInitStruct.PeriphClockSelection = RCC_PERIPHCLK_LTDC;
  PeriphClkInitStruct.PLLSAI.PLLSAIN = 100;
  PeriphClkInitStruct.PLLSAI.PLLSAIR = 2;
  PeriphClkInitStruct.PLLSAIDivR = RCC_PLLSAIDIVR_2;
  if (HAL_RCCEx_PeriphCLKConfig(&PeriphClkInitStruct) != HAL_OK)
  {
    Error_Handler();
  }
}

static void MX_ADC1_Init(void)
{

  ADC_ChannelConfTypeDef sConfig = {0};

  /** Configure the global features of the ADC (Clock, Resolution, Data Alignment and number of conversion)
  */
  hadc1.Instance = ADC1;
  hadc1.Init.ClockPrescaler = ADC_CLOCK_SYNC_PCLK_DIV4;
  hadc1.Init.Resolution = ADC_RESOLUTION_10B;
  hadc1.Init.ScanConvMode = ENABLE;
  hadc1.Init.ContinuousConvMode = ENABLE;
  hadc1.Init.DiscontinuousConvMode = DISABLE;
  hadc1.Init.ExternalTrigConvEdge = ADC_EXTERNALTRIGCONVEDGE_NONE;
  hadc1.Init.ExternalTrigConv = ADC_SOFTWARE_START;
  hadc1.Init.DataAlign = ADC_DATAALIGN_RIGHT;
  hadc1.Init.NbrOfConversion = 1;
  hadc1.Init.DMAContinuousRequests = DISABLE;
  hadc1.Init.EOCSelection = ADC_EOC_SINGLE_CONV;
  if (HAL_ADC_Init(&hadc1) != HAL_OK)
  {
    Error_Handler();
  }
  /** Configure for the selected ADC regular channel its corresponding rank in the sequencer and its sample time.
  */
  sConfig.Channel = ADC_CHANNEL_0;
  sConfig.Rank = 1;
  sConfig.SamplingTime = ADC_SAMPLETIME_3CYCLES;
  if (HAL_ADC_ConfigChannel(&hadc1, &sConfig) != HAL_OK)
  {
    Error_Handler();
  }

}

static void MX_CRC_Init(void)
{

  hcrc.Instance = CRC;
  if (HAL_CRC_Init(&hcrc) != HAL_OK)
  {
    Error_Handler();
  }

}

static void MX_DMA2D_Init(void)
{

  hdma2d.Instance = DMA2D;
  hdma2d.Init.Mode = DMA2D_R2M;
  hdma2d.Init.ColorMode = DMA2D_OUTPUT_RGB565;
  hdma2d.Init.OutputOffset = 0;
  if (HAL_DMA2D_Init(&hdma2d) != HAL_OK)
  {
    Error_Handler();
  }

}

static void MX_IWDG_Init(void)
{

  hiwdg.Instance = IWDG;
  hiwdg.Init.Prescaler = IWDG_PRESCALER_64;
  hiwdg.Init.Reload = 4000;
  if (HAL_IWDG_Init(&hiwdg) != HAL_OK)
  {
    Error_Handler();
  }

}

static void MX_LTDC_Init(void)
{

  LTDC_LayerCfgTypeDef pLayerCfg = {0};

  hltdc.Instance = LTDC;
  hltdc.Init.HSPolarity = LTDC_HSPOLARITY_AL;
  hltdc.Init.VSPolarity = LTDC_VSPOLARITY_AL;
  hltdc.Init.DEPolarity = LTDC_DEPOLARITY_AL;
  hltdc.Init.PCPolarity = LTDC_PCPOLARITY_IPC;
  hltdc.Init.HorizontalSync = 19;
  hltdc.Init.VerticalSync = 2;
  hltdc.Init.AccumulatedHBP = 159;
  hltdc.Init.AccumulatedVBP = 22;
  hltdc.Init.AccumulatedActiveW = 1183;
  hltdc.Init.AccumulatedActiveH = 622;
  hltdc.Init.TotalWidth = 1343;
  hltdc.Init.TotalHeigh = 632;
  hltdc.Init.Backcolor.Blue = 0;
  hltdc.Init.Backcolor.Green = 0;
  hltdc.Init.Backcolor.Red = 0;
  if (HAL_LTDC_Init(&hltdc) != HAL_OK)
  {
    Error_Handler();
  }
  pLayerCfg.WindowX0 = 0;
  pLayerCfg.WindowX1 = 0;
  pLayerCfg.WindowY0 = 0;
  pLayerCfg.WindowY1 = 0;
  pLayerCfg.PixelFormat = LTDC_PIXEL_FORMAT_RGB565;
  pLayerCfg.Alpha = 0;
  pLayerCfg.Alpha0 = 0;
  pLayerCfg.BlendingFactor1 = LTDC_BLENDING_FACTOR1_CA;
  pLayerCfg.BlendingFactor2 = LTDC_BLENDING_FACTOR2_CA;
  pLayerCfg.FBStartAdress = 0;
  pLayerCfg.ImageWidth = 0;
  pLayerCfg.ImageHeight = 0;
  pLayerCfg.Backcolor.Blue = 0;
  pLayerCfg.Backcolor.Green = 0;
  pLayerCfg.Backcolor.Red = 0;
  if (HAL_LTDC_ConfigLayer(&hltdc, &pLayerCfg, 0) != HAL_OK)
  {
    Error_Handler();
  }

}

static void MX_SPI5_Init(void)
{

  /* SPI5 parameter configuration*/
  hspi5.Instance = SPI5;
  hspi5.Init.Mode = SPI_MODE_MASTER;
  hspi5.Init.Direction = SPI_DIRECTION_2LINES;
  hspi5.Init.DataSize = SPI_DATASIZE_8BIT;
  hspi5.Init.CLKPolarity = SPI_POLARITY_LOW;
  hspi5.Init.CLKPhase = SPI_PHASE_1EDGE;
  hspi5.Init.NSS = SPI_NSS_SOFT;
  hspi5.Init.BaudRatePrescaler = SPI_BAUDRATEPRESCALER_2;
  hspi5.Init.FirstBit = SPI_FIRSTBIT_MSB;
  hspi5.Init.TIMode = SPI_TIMODE_DISABLE;
  hspi5.Init.CRCCalculation = SPI_CRCCALCULATION_DISABLE;
  hspi5.Init.CRCPolynomial = 10;
  if (HAL_SPI_Init(&hspi5) != HAL_OK)
  {
    Error_Handler();
  }

}

static void MX_TIM2_Init(void)
{

  TIM_ClockConfigTypeDef sClockSourceConfig = {0};
  TIM_MasterConfigTypeDef sMasterConfig = {0};
  TIM_OC_InitTypeDef sConfigOC = {0};

  htim2.Instance = TIM2;
  htim2.Init.Prescaler = 83;
  htim2.Init.CounterMode = TIM_COUNTERMODE_UP;
  htim2.Init.Period = 99;
  htim2.Init.ClockDivision = TIM_CLOCKDIVISION_DIV1;
  htim2.Init.AutoReloadPreload = TIM_AUTORELOAD_PRELOAD_DISABLE;
  if (HAL_TIM_Base_Init(&htim2) != HAL_OK)
  {
    Error_Handler();
  }
  sClockSourceConfig.ClockSource = TIM_CLOCKSOURCE_INTERNAL;
  if (HAL_TIM_ConfigClockSource(&htim2, &sClockSourceConfig) != HAL_OK)
  {
    Error_Handler();
  }
  if (HAL_TIM_PWM_Init(&htim2) != HAL_OK)
  {
    Error_Handler();
  }
  sMasterConfig.MasterOutputTrigger = TIM_TRGO_RESET;
  sMasterConfig.MasterSlaveMode = TIM_MASTERSLAVEMODE_DISABLE;
  if (HAL_TIMEx_MasterConfigSynchronization(&htim2, &sMasterConfig) != HAL_OK)
  {
    Error_Handler();
  }
  sConfigOC.OCMode = TIM_OCMODE_PWM1;
  sConfigOC.Pulse = 2120;
  sConfigOC.OCPolarity = TIM_OCPOLARITY_HIGH;
  sConfigOC.OCFastMode = TIM_OCFAST_DISABLE;
  if (HAL_TIM_PWM_ConfigChannel(&htim2, &sConfigOC, TIM_CHANNEL_1) != HAL_OK)
  {
    Error_Handler();
  }
  sConfigOC.OCMode = TIM_OCMODE_PWM2;
  sConfigOC.OCPolarity = TIM_OCPOLARITY_LOW;
  if (HAL_TIM_PWM_ConfigChannel(&htim2, &sConfigOC, TIM_CHANNEL_2) != HAL_OK)
  {
    Error_Handler();
  }
  HAL_TIM_MspPostInit(&htim2);

}

static void MX_TIM3_Init(void)
{

  TIM_ClockConfigTypeDef sClockSourceConfig = {0};
  TIM_MasterConfigTypeDef sMasterConfig = {0};

  htim3.Instance = TIM3;
  htim3.Init.Prescaler = 83;
  htim3.Init.CounterMode = TIM_COUNTERMODE_UP;
  htim3.Init.Period = 999;
  htim3.Init.ClockDivision = TIM_CLOCKDIVISION_DIV1;
  htim3.Init.AutoReloadPreload = TIM_AUTORELOAD_PRELOAD_DISABLE;
  if (HAL_TIM_Base_Init(&htim3) != HAL_OK)
  {
    Error_Handler();
  }
  sClockSourceConfig.ClockSource = TIM_CLOCKSOURCE_INTERNAL;
  if (HAL_TIM_ConfigClockSource(&htim3, &sClockSourceConfig) != HAL_OK)
  {
    Error_Handler();
  }
  sMasterConfig.MasterOutputTrigger = TIM_TRGO_RESET;
  sMasterConfig.MasterSlaveMode = TIM_MASTERSLAVEMODE_DISABLE;
  if (HAL_TIMEx_MasterConfigSynchronization(&htim3, &sMasterConfig) != HAL_OK)
  {
    Error_Handler();
  }

}

static void MX_TIM4_Init(void)
{

  TIM_ClockConfigTypeDef sClockSourceConfig = {0};
  TIM_MasterConfigTypeDef sMasterConfig = {0};

  htim4.Instance = TIM4;
  htim4.Init.Prescaler = 41;
  htim4.Init.CounterMode = TIM_COUNTERMODE_UP;
  htim4.Init.Period = 16383;
  htim4.Init.ClockDivision = TIM_CLOCKDIVISION_DIV1;
  htim4.Init.AutoReloadPreload = TIM_AUTORELOAD_PRELOAD_DISABLE;
  if (HAL_TIM_Base_Init(&htim4) != HAL_OK)
  {
    Error_Handler();
  }
  sClockSourceConfig.ClockSource = TIM_CLOCKSOURCE_INTERNAL;
  if (HAL_TIM_ConfigClockSource(&htim4, &sClockSourceConfig) != HAL_OK)
  {
    Error_Handler();
  }
  sMasterConfig.MasterOutputTrigger = TIM_TRGO_RESET;
  sMasterConfig.MasterSlaveMode = TIM_MASTERSLAVEMODE_DISABLE;
  if (HAL_TIMEx_MasterConfigSynchronization(&htim4, &sMasterConfig) != HAL_OK)
  {
    Error_Handler();
  }

}

static void MX_TIM10_Init(void)
{

  TIM_OC_InitTypeDef sConfigOC = {0};

  htim10.Instance = TIM10;
  htim10.Init.Prescaler = 167;
  htim10.Init.CounterMode = TIM_COUNTERMODE_UP;
  htim10.Init.Period = 99;
  htim10.Init.ClockDivision = TIM_CLOCKDIVISION_DIV1;
  htim10.Init.AutoReloadPreload = TIM_AUTORELOAD_PRELOAD_DISABLE;
  if (HAL_TIM_Base_Init(&htim10) != HAL_OK)
  {
    Error_Handler();
  }
  if (HAL_TIM_PWM_Init(&htim10) != HAL_OK)
  {
    Error_Handler();
  }
  if (HAL_TIM_OnePulse_Init(&htim10, TIM_OPMODE_SINGLE) != HAL_OK)
  {
    Error_Handler();
  }
  sConfigOC.OCMode = TIM_OCMODE_PWM1;
  sConfigOC.Pulse = 2120;
  sConfigOC.OCPolarity = TIM_OCPOLARITY_HIGH;
  sConfigOC.OCFastMode = TIM_OCFAST_DISABLE;
  if (HAL_TIM_PWM_ConfigChannel(&htim10, &sConfigOC, TIM_CHANNEL_1) != HAL_OK)
  {
    Error_Handler();
  }
  HAL_TIM_MspPostInit(&htim10);

}

static void MX_TIM11_Init(void)
{

  TIM_OC_InitTypeDef sConfigOC = {0};

  htim11.Instance = TIM11;
  htim11.Init.Prescaler = 83;
  htim11.Init.CounterMode = TIM_COUNTERMODE_UP;
  htim11.Init.Period = 999;
  htim11.Init.ClockDivision = TIM_CLOCKDIVISION_DIV1;
  htim11.Init.AutoReloadPreload = TIM_AUTORELOAD_PRELOAD_DISABLE;
  if (HAL_TIM_Base_Init(&htim11) != HAL_OK)
  {
    Error_Handler();
  }
  if (HAL_TIM_PWM_Init(&htim11) != HAL_OK)
  {
    Error_Handler();
  }
  sConfigOC.OCMode = TIM_OCMODE_PWM1;
  sConfigOC.Pulse = 0;
  sConfigOC.OCPolarity = TIM_OCPOLARITY_LOW;
  sConfigOC.OCFastMode = TIM_OCFAST_DISABLE;
  if (HAL_TIM_PWM_ConfigChannel(&htim11, &sConfigOC, TIM_CHANNEL_1) != HAL_OK)
  {
    Error_Handler();
  }
  HAL_TIM_MspPostInit(&htim11);

}

static void MX_USART1_UART_Init(void)
{

  huart1.Instance = USART1;
  huart1.Init.BaudRate = 115200;
  huart1.Init.WordLength = UART_WORDLENGTH_8B;
  huart1.Init.StopBits = UART_STOPBITS_1;
  huart1.Init.Parity = UART_PARITY_NONE;
  huart1.Init.Mode = UART_MODE_TX_RX;
  huart1.Init.HwFlowCtl = UART_HWCONTROL_NONE;
  huart1.Init.OverSampling = UART_OVERSAMPLING_16;
  if (HAL_UART_Init(&huart1) != HAL_OK)
  {
    Error_Handler();
  }

}

static void MX_DMA_Init(void)
{

  /* DMA controller clock enable */
  __HAL_RCC_DMA2_CLK_ENABLE();

  /* DMA interrupt init */
  /* DMA2_Stream5_IRQn interrupt configuration */
  HAL_NVIC_SetPriority(DMA2_Stream5_IRQn, 7, 0);
  HAL_NVIC_EnableIRQ(DMA2_Stream5_IRQn);
  /* DMA2_Stream7_IRQn interrupt configuration */
  HAL_NVIC_SetPriority(DMA2_Stream7_IRQn, 7, 0);
  HAL_NVIC_EnableIRQ(DMA2_Stream7_IRQn);

}

/* FMC initialization function */
static void MX_FMC_Init(void)
{

  FMC_NAND_PCC_TimingTypeDef ComSpaceTiming = {0};
  FMC_NAND_PCC_TimingTypeDef AttSpaceTiming = {0};
  FMC_SDRAM_TimingTypeDef SdramTiming = {0};

  /** Perform the NAND1 memory initialization sequence
  */
  hnand1.Instance = FMC_NAND_DEVICE;
  /* hnand1.Init */
  hnand1.Init.NandBank = FMC_NAND_BANK3;
  hnand1.Init.Waitfeature = FMC_NAND_PCC_WAIT_FEATURE_DISABLE;
  hnand1.Init.MemoryDataWidth = FMC_NAND_PCC_MEM_BUS_WIDTH_8;
  hnand1.Init.EccComputation = FMC_NAND_ECC_DISABLE;
  hnand1.Init.ECCPageSize = FMC_NAND_ECC_PAGE_SIZE_2048BYTE;
  hnand1.Init.TCLRSetupTime = 0;
  hnand1.Init.TARSetupTime = 0;
  /* hnand1.Config */
  hnand1.Config.PageSize = 2048;
  hnand1.Config.SpareAreaSize = 64;
  hnand1.Config.BlockSize = 64;
  hnand1.Config.BlockNbr = 4096;
  hnand1.Config.PlaneNbr = 0;
  hnand1.Config.PlaneSize = 0;
  hnand1.Config.ExtraCommandEnable = DISABLE;
  /* ComSpaceTiming */
  ComSpaceTiming.SetupTime = 2;
  ComSpaceTiming.WaitSetupTime = 3;
  ComSpaceTiming.HoldSetupTime = 2;
  ComSpaceTiming.HiZSetupTime = 1;
  /* AttSpaceTiming */
  AttSpaceTiming.SetupTime = 2;
  AttSpaceTiming.WaitSetupTime = 3;
  AttSpaceTiming.HoldSetupTime = 2;
  AttSpaceTiming.HiZSetupTime = 1;

  if (HAL_NAND_Init(&hnand1, &ComSpaceTiming, &AttSpaceTiming) != HAL_OK)
  {
    Error_Handler( );
  }

  /** Perform the SDRAM1 memory initialization sequence
  */
  hsdram1.Instance = FMC_SDRAM_DEVICE;
  /* hsdram1.Init */
  hsdram1.Init.SDBank = FMC_SDRAM_BANK1;
  hsdram1.Init.ColumnBitsNumber = FMC_SDRAM_COLUMN_BITS_NUM_9;
  hsdram1.Init.RowBitsNumber = FMC_SDRAM_ROW_BITS_NUM_13;
  hsdram1.Init.MemoryDataWidth = FMC_SDRAM_MEM_BUS_WIDTH_16;
  hsdram1.Init.InternalBankNumber = FMC_SDRAM_INTERN_BANKS_NUM_4;
  hsdram1.Init.CASLatency = FMC_SDRAM_CAS_LATENCY_3;
  hsdram1.Init.WriteProtection = FMC_SDRAM_WRITE_PROTECTION_DISABLE;
  hsdram1.Init.SDClockPeriod = FMC_SDRAM_CLOCK_PERIOD_2;
  hsdram1.Init.ReadBurst = FMC_SDRAM_RBURST_ENABLE;
  hsdram1.Init.ReadPipeDelay = FMC_SDRAM_RPIPE_DELAY_1;
  /* SdramTiming */
  SdramTiming.LoadToActiveDelay = 2;
  SdramTiming.ExitSelfRefreshDelay = 8;
  SdramTiming.SelfRefreshTime = 6;
  SdramTiming.RowCycleDelay = 6;
  SdramTiming.WriteRecoveryTime = 4;
  SdramTiming.RPDelay = 2;
  SdramTiming.RCDDelay = 2;

  if (HAL_SDRAM_Init(&hsdram1, &SdramTiming) != HAL_OK)
  {
    Error_Handler( );
  }

}

static void MX_GPIO_Init(void)
{
  GPIO_InitTypeDef GPIO_InitStruct = {0};

  /* GPIO Ports Clock Enable */
  __HAL_RCC_GPIOE_CLK_ENABLE();
  __HAL_RCC_GPIOB_CLK_ENABLE();
  __HAL_RCC_GPIOG_CLK_ENABLE();
  __HAL_RCC_GPIOD_CLK_ENABLE();
  __HAL_RCC_GPIOA_CLK_ENABLE();
  __HAL_RCC_GPIOC_CLK_ENABLE();
  __HAL_RCC_GPIOI_CLK_ENABLE();
  __HAL_RCC_GPIOH_CLK_ENABLE();
  __HAL_RCC_GPIOF_CLK_ENABLE();

  /*Configure GPIO pin Output Level */
  HAL_GPIO_WritePin(GPIOE, GD32_X_CS_Pin|GD32_HEAT_BED_Pin|GD32_Z_DIR_Pin, GPIO_PIN_RESET);

  /*Configure GPIO pin Output Level */
  HAL_GPIO_WritePin(GPIOB, GD32_LCD_BACKLIGHT_Pin|GD32_B_DIR_Pin|GD32_X2_STP_Pin|GD32_X2_DIR_Pin
                          |GD32_LIGHT_Pin|GD32_Y_STP_Pin|GD32_HEAT_CAVITY_Pin|GD32_Y_DIR_Pin, GPIO_PIN_RESET);

  /*Configure GPIO pin Output Level */
  HAL_GPIO_WritePin(GPIOG, GD32_X2_EN_Pin|GD32_Z_STP_Pin|GD32_E_EN_Pin|GD32_B_EN_Pin
                          |GD32_TOUCH_MISO_Pin, GPIO_PIN_RESET);

  /*Configure GPIO pin Output Level */
  HAL_GPIO_WritePin(GPIOD, GD32_Y_EN_Pin|GD32_E_STP_Pin|GD32_B_STP_Pin|GPIO_PIN_2
                          |GD32_FAN_FILTER_Pin, GPIO_PIN_RESET);

  /*Configure GPIO pin Output Level */
  HAL_GPIO_WritePin(GPIOC, GPIO_PIN_11|GPIO_PIN_10|GD32_LIGHT_BAR_Pin|GD32_Z_EN_Pin
                          |GD32_Y_CS_Pin|GD32_E_CS_Pin|GD32_B_CS_Pin, GPIO_PIN_RESET);

  /*Configure GPIO pin Output Level */
  HAL_GPIO_WritePin(GPIOI, GD32_TOUCH_MOSI_Pin|GD32_TOUCH_CS_Pin|GD32_X2_CS_Pin, GPIO_PIN_RESET);

  /*Configure GPIO pin Output Level */
  HAL_GPIO_WritePin(GPIOA, GD32_FAN_EB_MOTOR_Pin|GD32_HEAT_NOZ_E_Pin|GD32_Z_CS_Pin|GD32_HEAT_NOZ_B_Pin, GPIO_PIN_RESET);

  /*Configure GPIO pin Output Level */
  HAL_GPIO_WritePin(GPIOH, GD32_X_STP_Pin|GD32_X_DIR_Pin|GD32_X_EN_Pin|GD32_TOUCH_SCK_Pin
                          |GD32_E_DIR_Pin|GD32_TOUCH_PEN_Pin, GPIO_PIN_RESET);

  /*Configure GPIO pin : PE3 */
  GPIO_InitStruct.Pin = GPIO_PIN_3;
  GPIO_InitStruct.Mode = GPIO_MODE_IT_RISING;
  GPIO_InitStruct.Pull = GPIO_PULLUP;
  HAL_GPIO_Init(GPIOE, &GPIO_InitStruct);

  /*Configure GPIO pins : GD32_X_CS_Pin GD32_HEAT_BED_Pin GD32_Z_DIR_Pin */
  GPIO_InitStruct.Pin = GD32_X_CS_Pin|GD32_HEAT_BED_Pin|GD32_Z_DIR_Pin;
  GPIO_InitStruct.Mode = GPIO_MODE_OUTPUT_PP;
  GPIO_InitStruct.Pull = GPIO_NOPULL;
  GPIO_InitStruct.Speed = GPIO_SPEED_FREQ_LOW;
  HAL_GPIO_Init(GPIOE, &GPIO_InitStruct);

  /*Configure GPIO pins : GD32_SIG_SD_DETECT_Pin GD32_SIG_Y_Pin */
  GPIO_InitStruct.Pin = GD32_SIG_SD_DETECT_Pin|GD32_SIG_Y_Pin;
  GPIO_InitStruct.Mode = GPIO_MODE_INPUT;
  GPIO_InitStruct.Pull = GPIO_PULLUP;
  HAL_GPIO_Init(GPIOB, &GPIO_InitStruct);

  /*Configure GPIO pin : GD32_LCD_BACKLIGHT_Pin */
  GPIO_InitStruct.Pin = GD32_LCD_BACKLIGHT_Pin;
  GPIO_InitStruct.Mode = GPIO_MODE_OUTPUT_PP;
  GPIO_InitStruct.Pull = GPIO_PULLUP;
  GPIO_InitStruct.Speed = GPIO_SPEED_FREQ_VERY_HIGH;
  HAL_GPIO_Init(GD32_LCD_BACKLIGHT_GPIO_Port, &GPIO_InitStruct);

  /*Configure GPIO pins : GD32_X2_EN_Pin GD32_Z_STP_Pin GD32_E_EN_Pin GD32_B_EN_Pin
                           GD32_TOUCH_MISO_Pin */
  GPIO_InitStruct.Pin = GD32_X2_EN_Pin|GD32_Z_STP_Pin|GD32_E_EN_Pin|GD32_B_EN_Pin
                          |GD32_TOUCH_MISO_Pin;
  GPIO_InitStruct.Mode = GPIO_MODE_OUTPUT_PP;
  GPIO_InitStruct.Pull = GPIO_NOPULL;
  GPIO_InitStruct.Speed = GPIO_SPEED_FREQ_LOW;
  HAL_GPIO_Init(GPIOG, &GPIO_InitStruct);

  /*Configure GPIO pins : GD32_B_DIR_Pin GD32_X2_STP_Pin GD32_X2_DIR_Pin GD32_LIGHT_Pin
                           GD32_Y_STP_Pin GD32_HEAT_CAVITY_Pin GD32_Y_DIR_Pin */
  GPIO_InitStruct.Pin = GD32_B_DIR_Pin|GD32_X2_STP_Pin|GD32_X2_DIR_Pin|GD32_LIGHT_Pin
                          |GD32_Y_STP_Pin|GD32_HEAT_CAVITY_Pin|GD32_Y_DIR_Pin;
  GPIO_InitStruct.Mode = GPIO_MODE_OUTPUT_PP;
  GPIO_InitStruct.Pull = GPIO_NOPULL;
  GPIO_InitStruct.Speed = GPIO_SPEED_FREQ_LOW;
  HAL_GPIO_Init(GPIOB, &GPIO_InitStruct);

  /*Configure GPIO pins : GD32_Y_EN_Pin GD32_E_STP_Pin GD32_B_STP_Pin PD2
                           GD32_FAN_FILTER_Pin */
  GPIO_InitStruct.Pin = GD32_Y_EN_Pin|GD32_E_STP_Pin|GD32_B_STP_Pin|GPIO_PIN_2
                          |GD32_FAN_FILTER_Pin;
  GPIO_InitStruct.Mode = GPIO_MODE_OUTPUT_PP;
  GPIO_InitStruct.Pull = GPIO_NOPULL;
  GPIO_InitStruct.Speed = GPIO_SPEED_FREQ_LOW;
  HAL_GPIO_Init(GPIOD, &GPIO_InitStruct);

  /*Configure GPIO pin : GD32_SIG_DOOR_Pin */
  GPIO_InitStruct.Pin = GD32_SIG_DOOR_Pin;
  GPIO_InitStruct.Mode = GPIO_MODE_INPUT;
  GPIO_InitStruct.Pull = GPIO_PULLUP;
  HAL_GPIO_Init(GD32_SIG_DOOR_GPIO_Port, &GPIO_InitStruct);

  /*Configure GPIO pins : PC11 PC10 GD32_LIGHT_BAR_Pin GD32_Z_EN_Pin
                           GD32_Y_CS_Pin GD32_E_CS_Pin GD32_B_CS_Pin */
  GPIO_InitStruct.Pin = GPIO_PIN_11|GPIO_PIN_10|GD32_LIGHT_BAR_Pin|GD32_Z_EN_Pin
                          |GD32_Y_CS_Pin|GD32_E_CS_Pin|GD32_B_CS_Pin;
  GPIO_InitStruct.Mode = GPIO_MODE_OUTPUT_PP;
  GPIO_InitStruct.Pull = GPIO_NOPULL;
  GPIO_InitStruct.Speed = GPIO_SPEED_FREQ_LOW;
  HAL_GPIO_Init(GPIOC, &GPIO_InitStruct);

  /*Configure GPIO pins : GD32_TOUCH_MOSI_Pin GD32_TOUCH_CS_Pin GD32_X2_CS_Pin */
  GPIO_InitStruct.Pin = GD32_TOUCH_MOSI_Pin|GD32_TOUCH_CS_Pin|GD32_X2_CS_Pin;
  GPIO_InitStruct.Mode = GPIO_MODE_OUTPUT_PP;
  GPIO_InitStruct.Pull = GPIO_NOPULL;
  GPIO_InitStruct.Speed = GPIO_SPEED_FREQ_LOW;
  HAL_GPIO_Init(GPIOI, &GPIO_InitStruct);

  /*Configure GPIO pins : GD32_SIG_Z_MAX_Pin GD32_SIG_Z_MIN_Pin GD32_SIG_MAT_E1_Pin */
  GPIO_InitStruct.Pin = GD32_SIG_Z_MAX_Pin|GD32_SIG_Z_MIN_Pin|GD32_SIG_MAT_E1_Pin;
  GPIO_InitStruct.Mode = GPIO_MODE_INPUT;
  GPIO_InitStruct.Pull = GPIO_PULLUP;
  HAL_GPIO_Init(GPIOC, &GPIO_InitStruct);

  /*Configure GPIO pin : GD32_SIG_X_Pin */
  GPIO_InitStruct.Pin = GD32_SIG_X_Pin;
  GPIO_InitStruct.Mode = GPIO_MODE_INPUT;
  GPIO_InitStruct.Pull = GPIO_PULLUP;
  HAL_GPIO_Init(GD32_SIG_X_GPIO_Port, &GPIO_InitStruct);

  /*Configure GPIO pins : GD32_FAN_EB_MOTOR_Pin GD32_HEAT_NOZ_E_Pin GD32_Z_CS_Pin GD32_HEAT_NOZ_B_Pin */
  GPIO_InitStruct.Pin = GD32_FAN_EB_MOTOR_Pin|GD32_HEAT_NOZ_E_Pin|GD32_Z_CS_Pin|GD32_HEAT_NOZ_B_Pin;
  GPIO_InitStruct.Mode = GPIO_MODE_OUTPUT_PP;
  GPIO_InitStruct.Pull = GPIO_NOPULL;
  GPIO_InitStruct.Speed = GPIO_SPEED_FREQ_LOW;
  HAL_GPIO_Init(GPIOA, &GPIO_InitStruct);

  /*Configure GPIO pins : GD32_X_STP_Pin GD32_X_DIR_Pin GD32_X_EN_Pin GD32_TOUCH_SCK_Pin
                           GD32_E_DIR_Pin GD32_TOUCH_PEN_Pin */
  GPIO_InitStruct.Pin = GD32_X_STP_Pin|GD32_X_DIR_Pin|GD32_X_EN_Pin|GD32_TOUCH_SCK_Pin
                          |GD32_E_DIR_Pin|GD32_TOUCH_PEN_Pin;
  GPIO_InitStruct.Mode = GPIO_MODE_OUTPUT_PP;
  GPIO_InitStruct.Pull = GPIO_NOPULL;
  GPIO_InitStruct.Speed = GPIO_SPEED_FREQ_LOW;
  HAL_GPIO_Init(GPIOH, &GPIO_InitStruct);

  /*Configure GPIO pins : GD32_SIG_MAT_E0_Pin GD32_SIG_X2_Pin */
  GPIO_InitStruct.Pin = GD32_SIG_MAT_E0_Pin|GD32_SIG_X2_Pin;
  GPIO_InitStruct.Mode = GPIO_MODE_INPUT;
  GPIO_InitStruct.Pull = GPIO_PULLUP;
  HAL_GPIO_Init(GPIOA, &GPIO_InitStruct);

  /* EXTI interrupt init*/
  HAL_NVIC_SetPriority(EXTI3_IRQn, 0, 0);
  HAL_NVIC_EnableIRQ(EXTI3_IRQn);

}

void InitTask_OS(void const * argument)
{
  /* init code for USB_HOST */
  MX_USB_HOST_Init();

  /* init code for USB_DEVICE */
  MX_USB_DEVICE_Init();
  for(;;)
  {
    osDelay(1);
  }
}

void RefDataTask_OS(void const * argument)
{
  /* USER CODE BEGIN RefDataTask_OS */
  argument=argument;
  /* Infinite loop */
  for(;;)
  {
    osDelay(1);
  }
  /* USER CODE END RefDataTask_OS */
}

void ReadUdiskTask_OS(void const * argument)
{
  /* USER CODE BEGIN ReadUdiskTask_OS */
  argument=argument;
  /* Infinite loop */
  for(;;)
  {
    osDelay(1);
  }
  /* USER CODE END ReadUdiskTask_OS */
}

void PrintTask_OS(void const * argument)
{
  /* USER CODE BEGIN PrintTask_OS */
  argument=argument;
  /* Infinite loop */
  for(;;)
  {
    osDelay(1);
  }
  /* USER CODE END PrintTask_OS */
}

void GUITask_OS(void const * argument)
{
  /* USER CODE BEGIN GUITask_OS */
  argument=argument;
  /* Infinite loop */
  for(;;)
  {
    osDelay(1);
  }
  /* USER CODE END GUITask_OS */
}

void RespondGUITask_OS(void const * argument)
{
  /* USER CODE BEGIN RespondGUITask_OS */
  argument=argument;
  /* Infinite loop */
  for(;;)
  {
    osDelay(1);
  }
  /* USER CODE END RespondGUITask_OS */
}

 /**
  * @brief  Period elapsed callback in non blocking mode
  * @note   This function is called  when TIM1 interrupt took place, inside
  * HAL_TIM_IRQHandler(). It makes a direct call to HAL_IncTick() to increment
  * a global variable "uwTick" used as application time base.
  * @param  htim : TIM handle
  * @retval None
  */
void HAL_TIM_PeriodElapsedCallback(TIM_HandleTypeDef *htim)
{
  if (htim->Instance == TIM1) {
    HAL_IncTick();
  }
}

void Error_Handler(void)
{
  __disable_irq();
  while (1)
  {
  }
}

/************************ (C) COPYRIGHT STMicroelectronics *****END OF FILE****/
